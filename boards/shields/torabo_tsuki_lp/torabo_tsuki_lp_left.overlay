#include "torabo_tsuki_lp.dtsi"
#include <input/processors.dtsi>
#include <dt-bindings/zmk/input_transform.h>

/ {
    left_scroll_listener: left_scroll_listener {
        compatible = "zmk,input-listener";
        device = <&trackball>;
        status = "okay";
    input-processors = 
        <&zip_xy_transform (INPUT_TRANSFORM_X_INVERT | INPUT_TRANSFORM_Y_INVERT)>,
        <&zip_scroll_scaler 2 1>,
        <&zip_xy_scaler 0 0>; // ポインタ移動を消去してスクロールのみにする
};
};
