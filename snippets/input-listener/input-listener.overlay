#include <dt-bindings/zmk/input_transform.h>
#include <input/processors/sensor_rotation.dtsi>

&pointing_listener {
    status = "okay";
    device = <&pointing_device>;
    input-processors = <
        &zip_xy_transform (INPUT_TRANSFORM_XY_SWAP | INPUT_TRANSFORM_Y_INVERT)
    >;
};
